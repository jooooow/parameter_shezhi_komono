#include "oled2.h"
#include "stdlib.h"
#include "stdio.h"
#include "usart3.h"

const unsigned char F6x8[][6] =		
{
0x00, 0x00, 0x00, 0x00, 0x00, 0x00,// sp
0x00, 0x00, 0x00, 0x2f, 0x00, 0x00,// !
0x00, 0x00, 0x07, 0x00, 0x07, 0x00,// "
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0x00, 0x00, 0xFF, 0xFF, 0x00, 0x00 // |
};

u8 gImage_hll_icon_data[378] = { /* 0X22,0X01,0X36,0X00,0X36,0X00, */
0X00,0X00,0X00,0X00,0X00,0X00,0X00,0X00,0X00,0X80,0XC0,0XE0,0XF0,0XF0,0XF8,0XF8,
0XFC,0XFC,0XFC,0XFE,0XFE,0XFE,0XFE,0XFF,0XFF,0XFF,0XFF,0XFF,0XFF,0XFF,0XFF,0XFE,
0XFE,0XFE,0XFE,0XFC,0XFC,0XFC,0XF8,0XF8,0XF0,0XF0,0XE0,0XC0,0X80,0X00,0X00,0X00,
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0X00,0X00,0X00,0X00,0X00,0X00,0X00,0X00,0X00,0X00,};

extern "C"
{
#include "spi.h"
#include "delay.h"
}

Oled::Oled(u8 h, u8 w) : height(h), width(w)
{
	printf("oled init!\r\n");
	
	InitGpio();
	InitOled();
	
	ShowImg(37,0,91,7,gImage_hll_icon_data);
	ShowString(5,6,"K1:set K4:debug");
	
	printf("oled init done!\r\n");
}

Oled::~Oled()
{
	
}

u8 Oled::GetHeight()
{
	return height;
}

u8 Oled::GetWidth()
{
	return width;
}

void Oled::SetLayout(VerticalLayout* l, VerticalLayout* r)
{
	layout_left = l;
	layout_right = r;
	
	layout_left_x = l->GetLeftMargin() * 8;
	layout_right_x = (l->GetLeftMargin() + l->GetMaxWidth() + r->GetLeftMargin()) * 8;
}

void Oled::InitGpio()
{
	InitSPI4();
	InitGPIO();
}

void Oled::InitOled()
{
	REST = 1;
  delay_ms(200);
  REST = 0;
  delay_ms(200);
  REST = 1; 

  WriteCmd(0xAE);
  WriteCmd(0x00);
  WriteCmd(0x10);
  WriteCmd(0x40);
  WriteCmd(0x81);
  WriteCmd(0xCF);
  WriteCmd(0xA1);
  WriteCmd(0xC8);
  WriteCmd(0xA6);
  WriteCmd(0xA8);
  WriteCmd(0x3f);
  WriteCmd(0xD3);
  WriteCmd(0x00);
  WriteCmd(0xd5);
  WriteCmd(0x80);
  WriteCmd(0xD9);
  WriteCmd(0xF1);
  WriteCmd(0xDA);
  WriteCmd(0x12);
  WriteCmd(0xDB);
  WriteCmd(0x40);
  WriteCmd(0x20);
  WriteCmd(0x02);
  WriteCmd(0x8D);
  WriteCmd(0x14);
  WriteCmd(0xA4);
  WriteCmd(0xA6);
  WriteCmd(0xAF);

  WriteCmd(0xAF);
	ClearAll();
	SetPosition(0,0);
}

void Oled::ClearAll()
{
	u8 page,len;
	for(page=0;page<8;page++)
	{
		WriteCmd(0xB0+page);
		WriteCmd(0X02);
		WriteCmd(0X10);
		
		for(len=0;len<128;len++)
			WriteData(0);
	}
}

void Oled::ShowChar(u8 x, u8 y, u8 ch)
{
	u8 i=0;
	u8 ret=0;
  ret = ch - ' ';
  if(x > 128-1)
  {
		x = 0;
		y = y + 2;
  }
  
  SetPosition(x,y+1);
  for(i=0;i<6;i++)
  {
		WriteData(F6x8[ret][i]);
	}
}

void Oled::ShowString(u8 x,u8 y,const char *str)
{
	u8 i=0;

  while(str[i]!='\0')
  {
		ShowChar(x,y,str[i]);
		x += 8;
		if(x>120)
		{
			x = 0;
			y += 2;
		}
		i++;
	}
}

void Oled::ShowImg(u8 x0,u8 y0,u8 x1,u8 y1,u8 img[])
{
	u8 x,y;
  u32 i=0;

  if(y1%8==0)
      y = y1 / 8;
  else
      y = y1 /8 + 1;
  for(y=y0;y<y1;y++)
  {
		SetPosition(x0,y);
		for(x=x0;x<x1;x++)
		{
			WriteData(img[i++]);
		}
  }
}

void Oled::SetPosition(u8 x, u8 y)
{
	WriteCmd(0xb0+y);
  WriteCmd(((x&0xf0)>>4)|0x10);
  WriteCmd((x&0x0f)|0X01);
}

void Oled::WriteByte(u8 byt)
{
    SPI4ReadWriteByte(byt);
}

void Oled::WriteData(u8 dat)
{
    CS = 0;
    DC = 1;
    WriteByte(dat);
}

void Oled::WriteCmd(u8 cmd)
{
    CS = 0;
		DC = 0;
    WriteByte(cmd);
}

void Oled::Update()
{
	UpdateLeft();
	UpdateRight();
}

void Oled::UpdateLeft()
{
	for(u8 i = 0; i < layout_left->GetCurHeight(); i++)
	{
		ShowString(layout_left_x,i,layout_left->GetAt(i)->str);
	}
}

void Oled::UpdateRight()
{
	for(u8 i = 0; i < layout_right->GetCurHeight(); i++)
	{
		ShowString(layout_right_x,i,layout_right->GetAt(i)->str);
	}
}

void Oled::Push2Left(const char* str, u8 direction)
{
	if(direction)
		layout_left->PushBack(str);
	else
		layout_left->PushFront(str);
}

void Oled::Push2Right(const char* str, u8 direction)
{
	if(direction)
		layout_right->PushBack(str);
	else
		layout_right->PushFront(str);
}

void Oled::ClearRight()
{
	for(int i = 0; i < layout_right->GetCurHeight(); i++)
		ShowString(layout_right_x,i,"       ");
	layout_right->Clear();
}

void Oled::ClearLeft()
{
	for(int i = 0; i < layout_left->GetCurHeight(); i++)
		ShowString(layout_left_x,i,"       ");
	layout_left->Clear();
}
